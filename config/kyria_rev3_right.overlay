#include "shared.dtsi"

&pro_micro_i2c {
    status = "okay";

    glidepoint: glidepoint@2a {
        compatible = "cirque,pinnacle";
        reg = <0x2a>;
        status = "okay";
        dr-gpios = <&pro_micro 1 (GPIO_ACTIVE_LOW)>;

        y-invert;
        sensitivity = "1x";
    };
};

&glidepoint_split {
    device = <&glidepoint>;
};
