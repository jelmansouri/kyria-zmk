## config/west.yml
```yaml
manifest:
  remotes:
    - name: zmkfirmware
      url-base: https://github.com/zmkfirmware
    # Additional modules containing boards/shields/custom code can be listed here as well
    - name: petejohanson
      url-base: https://github.com/petejohanson
    - name: urob
      url-base: https://github.com/urob
    - name: jelmansouri
      url-base: https://github.com/jelmansouri
  projects:
    - name: zmk
      remote: zmkfirmware
      revision: 4ec69cb7e658590adf6354027aca789b364a70c5
      import: app/west.yml
    - name: cirque-input-module
      remote: petejohanson
      revision: main
    - name: zmk-auto-layer
      remote: jelmansouri
      revision: fix/modifier-exclusivity
  self:
    path: config
```
